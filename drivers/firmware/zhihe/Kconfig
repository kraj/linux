## drivers/firmware/zhihe/Kconfig
```kconfig
# SPDX-License-Identifier: GPL-2.0-only
config ZHIHE_AON
	bool "zhihe Aon Protocol driver"
	depends on ZHIHE_MBOX
	default y
	help
	  ZHIHE Aon is a low-level system function which runs a dedicated
	  ZHIHE riscv E902 core to provide power, clock and resource management.

	  This driver manages the IPC interface between host cpu liks thead
	  and the Aon firmware running on thead riscv E902 core.

config ZHIHE_PROC_DEBUG
       bool "ZHIHE debug"
       help
         proc_debug
```

## drivers/gpu/drm/verisilicon/Kconfig
```kconfig
# SPDX-License-Identifier: GPL-2.0

config DRM_VERISILICON
	tristate "DRM Support for VeriSilicon"
	depends on DRM
	select DRM_KMS_HELPER
	select VERISILICON_DW_MIPI_DSI
	select VERISILICON_DW_HDMI_TH1520
	help
	  Choose this option if you have a VeriSilicon soc chipset.
	  This driver provides VeriSilicon kernel mode
	  setting and buffer management. It does not
	  provide 2D or 3D acceleration.

config VERISILICON_VIRTUAL_DISPLAY
	bool "display content output to debugfs file"
	depends on DRM_VERISILICON
	select DEBUG_FS
	help
	  This is a debug feature which capture video content output
	  from display controller. Output path is debugfs/dri/connector/.
	  The content format is ARGB which Alpha is 0 for 8bits.
	  Disabled in default.

config VERISILICON_DW_MIPI_DSI
	bool "VeriSilicon specific driver for Synopsys DW MIPI DSI"
	depends on DRM_VERISILICON
	select DRM_MIPI_DSI
	select GENERIC_PHY
	select GENERIC_PHY_MIPI_DPHY
	select PHY_DW_DPHY
	help
	  This driver supports Synopsys DW MIPI DSI controller.
	  MIPI DSI controller is a bridge between encoder
	  and panel. Also it is a MIPI DSI host and can work
	  in dual mode.

config VERISILICON_DW_HDMI_TH1520
	bool "XUANTIE sepcific driver for Synopsys DW HDMI on TH1520"
	depends on DRM_VERISILICON
	select DRM_DW_HDMI
	help
	  This driver supports Synopsys DW HDMI controller on TH1520
	  platform from XUANTIE Corp.

config VERISILICON_DW_DP_P100
	bool "THEAD sepcific driver for Synopsys DW DP on P100"
	depends on DRM_VERISILICON
	select DRM_DW_DP
	select DRM_DP
	select DRM_DISPLAY_HDCP_HELPER
	select DRM_DISPLAY_DP_HELPER
	help
	  This driver supports Synopsys DW DP controller on P100
	  platform from THEAD Corp.

config VERISILICON_MMU
	bool "MMU support for VeriSilicon display controller"
	depends on DRM_VERISILICON
	help
	  This is a memory management function which translate virtual address
	  to physical address. DPU MMU only do address translate, doesn't
	  support shareable.

config VERISILICON_DEC
	bool "DEC support for VeriSilicon display controller"
	depends on DRM_VERISILICON
	help
	  This is a decompression function which reads compressed pixels from
	  external memory (DDR or SRAM) under DPU's control, then it decompress
	  comprssed pixels before returing these pixels to DPU.

config ZHIHE_AUXDISP
	bool "Auxiliary Display CRTC support"
	depends on DRM_VERISILICON
	help
	  Enable support for auxiliary display CRTC device.
	  This CRTC can connect to HDMI and DisplayPort outputs,
	  providing additional display pipeline for external monitors.
	  It supports up to 10-bit color depth and multiple color formats
	  including RGB444, YCbCr444, and YCbCr422.
```

## drivers/phy/zhihe/Kconfig
```kconfig
#SPDX-License-Identifier: GPL-2.0-only

config PHY_DW_DPHY
	tristate "Synopsys DesignWare MIPI D-PHY Support"
	depends on HAS_IOMEM && OF
	select GENERIC_PHY
	select GENERIC_PHY_MIPI_DPHY
	help
	  Choose this option if you have DesignWare D-PHY in your system.
	  If M is selected, the module will be called dw-dphy.

config PHY_ZHIHE_SNPS_PCIE3
	tristate "Zhihe Snps PCIe3 PHY Driver"
	depends on (ARCH_ZHIHE && OF) || COMPILE_TEST
	depends on HAS_IOMEM
	select GENERIC_PHY
	select MFD_SYSCON
	help
	  Enable this to support the ZHIHE snps PCIe3 PHY.

config PHY_ZHIHE_SNPS_USB2
	tristate "Zhihe Snps USB2.0 PHY Driver"
	depends on (ARCH_ZHIHE && OF) || COMPILE_TEST
	depends on HAS_IOMEM
	select GENERIC_PHY
	help
	  Enable this to support the ZHIHE Snps USB 2.0 PHY.
	  This driver provides PHY support for the USB 2.0 controllers
	  on ZHIHE platforms.

config PHY_ZHIHE_SNPS_C10PHY
	tristate "ZHIHE C10PHY USB3.1 PHY Driver"
	depends on ARCH_ZHIHE || COMPILE_TEST
	depends on HAS_IOMEM
	select GENERIC_PHY
	help
	  Enable this to support the ZHIHE C10PHY USB3.1 PHY.
	  This PHY is used in ZHIHE A210 SoCs for USB 3.1 functionality.

	  To compile this driver as a module, choose M here: the
	  module will be called phy-c10phy.
```

## drivers/soc/zhihe/Kconfig
```kconfig
# SPDX-License-Identifier: GPL-2.0-only

menu "ZHIHE SoC drivers"

config A210_MEMTESTER
	tristate "ZHIHE A210 memtester support"
	default y
	help
	  This driver supports A210 memtester feature.

config A210_POWER_DOMAIN
	bool "A210 Power Domain driver"
	depends on PM
	select PM_GENERIC_DOMAINS
	default y
	help
	  This is the power domain driver that controls PCU/PPU for A210 Soc.

config A210_BMU
        tristate "A210 bmu driver"
        default n
        help
          This driver provides support for A210 bmu.

config A210_D2D
	tristate "A210 d2d driver"
	default n
	help
	  This is the d2d driver for A210 Soc.

endmenu
```

## sound/soc/zhihe/Kconfig
```kconfig
# SPDX-License-Identifier: GPL-2.0-only

menu "ASoC support for ZHIHE"

config SND_SOC_ZHIHE_PCM
	tristate "Zhihe Dummy PCM And PCM DMA Support"
	default n

config SND_SOC_ZHIHE_I2S
	tristate "Zhihe I2S Driver Support"
	select SND_SOC_GENERIC_DMAENGINE_PCM
	select SND_SOC_ZHIHE_PCM
	default n
	help
	  Say Y or M if you want to add support for codecs or HDMI PCM
	  attached to the SND_SOC_ZHIHE_I2S interface.

config SND_SOC_ZHIHE_TDM
	tristate "Zhihe TDM Driver Support"
	select SND_SOC_GENERIC_DMAENGINE_PCM
	select SND_SOC_ZHIHE_PCM
	default n
	help
	  Say Y or M if you want to add support for codecs
	  attached to the SND_SOC_ZHIHE_TDM interface.
	  Codecs support up to 8 slots of recording.

config SND_SOC_ZHIHE_PDM
	tristate "Zhihe PDM Driver Support"
	select SND_SOC_GENERIC_DMAENGINE_PCM
	select SND_SOC_ZHIHE_PCM
	select SND_SOC_DMIC
	default n
	help
	  Say Y or M if you want to add support for Digital Mic
	  attached to the SND_SOC_ZHIHE_PDM interface.
	  Codecs support up to 8 channels of recording.

endmenu
```
